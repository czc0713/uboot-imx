## board/freescale/hzcarIMX6QDL/Kconfig
```kconfig
if TARGET_MX6QDL_HZ

config SYS_BOARD
	default "hzcarIMX6QDL"

config SYS_VENDOR
	default "freescale"

config SYS_SOC
	default "mx6"

config SYS_CONFIG_NAME
	default "hzcarIMX6QDL"

endif
```

## configs/hz_mx6dl_spinor_defconfig
```kconfig
CONFIG_SYS_EXTRA_OPTIONS="IMX_CONFIG=board/freescale/hzcarIMX6QDL/mx6dlsabresd.cfg,MX6DL,SYS_BOOT_SPINOR,ANDROID_SUPPORT"
CONFIG_ARM=y
CONFIG_TARGET_MX6QDL_HZ=y
CONFIG_SYS_MALLOC_F=y
CONFIG_SYS_MALLOC_F_LEN=0x400
CONFIG_DM=y
CONFIG_DM_THERMAL=y
```
